## CMakeLists.txt
```
#
# nRF54L15 Tag Demo
#
cmake_minimum_required(VERSION 3.20.0)
find_package(Zephyr REQUIRED HINTS $ENV{ZEPHYR_BASE})

project(nRF54L15TagDemo)

# main.c lives at the top level; each functional area is a self-contained
# module under src/ with its own CMakeLists.txt and Kconfig.
target_sources(app PRIVATE src/main.c)

add_subdirectory(src/sensors)
add_subdirectory(src/ble)
add_subdirectory(src/cs)
add_subdirectory(src/ess)
add_subdirectory(src/dis)
add_subdirectory(src/motion)
add_subdirectory(src/tput)
add_subdirectory(src/ux)
add_subdirectory(src/control)
add_subdirectory(src/dfu)
```

## Kconfig
```
# nRF54L15 Tag Demo application configuration

menu "Tag Demo"

rsource "src/sensors/Kconfig"
rsource "src/ble/Kconfig"
rsource "src/cs/Kconfig"
rsource "src/ess/Kconfig"
rsource "src/dis/Kconfig"
rsource "src/motion/Kconfig"
rsource "src/tput/Kconfig"
rsource "src/ux/Kconfig"
rsource "src/control/Kconfig"
rsource "src/dfu/Kconfig"

endmenu

source "Kconfig.zephyr"
```

## sysbuild.conf
```
# Build MCUboot as a first-stage bootloader so the application can be updated
# over the SMP-over-Bluetooth transport already configured in prj.conf.
#
# Everything else is left at the NCS defaults for SOC_SERIES_NRF54L:
#   - mode         : swap-using-move (test-then-confirm, automatic revert)
#   - signature    : ED25519, image hash SHA512
#   - signing key  : MCUboot's stock bootloader/mcuboot/root-ed25519.pem
#                    (a publicly known development key — see README)
#   - partitions   : from devicetree; Kconfig.sysbuild sets PARTITION_MANAGER=n
#   - max sectors  : BOOT_MAX_IMG_SECTORS_AUTO defaults y without Partition
#                    Manager, which matters here (712K / 4K = 178 sectors, well
#                    over the static default of 128).
SB_CONFIG_BOOTLOADER_MCUBOOT=y

# Produce a single merged_<board>.hex containing MCUboot + the signed
# application, so a factory/first-time flash is one artifact over J-Link.
SB_CONFIG_MERGED_HEX_FILES=y
```

## west.yml
```
# West manifest — nRF54L15 Tag Demo (T2 topology: this repo is the manifest repo).
#
# Bootstrap a workspace with:
#   west init -m https://github.com/onceLabs/nRF54L15-Tag-Demo --mr main <ws>
#   cd <ws> && west update --narrow -o=--depth=1
#
# The import allow-list pulls only the nRF Connect SDK modules this application
# builds against (derived from the app's compile_commands.json), excluding the
# large unused stacks (Matter, LVGL, TF-M, OpenThread, Wi-Fi, LoRaMAC, ...).
manifest:
  version: "1.0"

  remotes:
    - name: nrfconnect
      url-base: https://github.com/nrfconnect

  projects:
    - name: sdk-nrf
      remote: nrfconnect
      repo-path: sdk-nrf
      revision: v3.4.0
      path: nrf              # NCS build glue expects the SDK tree at nrf/
      import:
        name-allowlist:
          - zephyr             # core RTOS
          - nrfxlib            # SoftDevice Controller + MPSL + crypto libs
          - hal_nordic         # nrfx + MDK (nRF54L15)
          - cmsis              # CMSIS core
          - cmsis_6            # CMSIS 6
          - cmsis-dsp          # FFT/DSP used by cs_de
          - mbedtls            # nrf_security backend
          - oberon-psa-crypto  # PSA crypto (BLE SMP / MCUmgr)
          - tf-psa-crypto      # NCS 3.4 PSA crypto integration
          - picolibc           # C library
          - segger             # RTT (console / log / shell)
          - zcbor              # MCUmgr / SMP encoding
          - mcuboot            # bootloader (OTA/DFU over SMP) — see sysbuild.conf

  self:
    path: nRF54L15TagDemo
```

## prj.conf
```kconfig
# ============================================================================
# nRF54L15 Tag Demo — dual-role, dual-mode (RAS + inline-PCT) Channel Sounding
#                     plus onboard sensors (BME688, ADXL367, BMI270).
# ============================================================================

CONFIG_NCS_SAMPLES_DEFAULTS=y
CONFIG_DK_LIBRARY=y

# --- Bluetooth: dual-role (initiator = central, reflector = peripheral) ------
CONFIG_BT=y
CONFIG_BT_SMP=y
CONFIG_BT_PERIPHERAL=y
CONFIG_BT_CENTRAL=y
# Two simultaneous links: outbound central (CS reflector) + inbound peripheral
# (screen / phone / SMP host). The initiator advertises for a host while ranging.
CONFIG_BT_MAX_CONN=2
CONFIG_BT_MAX_PAIRED=2
CONFIG_BT_BONDABLE=n
CONFIG_BT_DEVICE_NAME="nRF54L15 Tag"

CONFIG_BT_GATT_CLIENT=y
CONFIG_BT_GATT_DYNAMIC_DB=y

# --- Device Information Service (SIG, 0x180A) -------------------------------
# Zephyr's DIS is a BT_GATT_SERVICE_DEFINE inside the stack, so enabling it here
# is enough — it self-registers at boot with no init call (cf. src/dis, which
# only fills in the runtime serial number).
CONFIG_BT_DIS=y
CONFIG_BT_DIS_MANUF_NAME=y
CONFIG_BT_DIS_MANUF_NAME_STR="Hero Instruments, Inc"
# Without this the model number defaults to the SoC name, "nrf54l15".
CONFIG_BT_DIS_MODEL_NUMBER=y
CONFIG_BT_DIS_MODEL_NUMBER_STR="nRF54L15 Tag"
# Firmware revision is deliberately NOT given a string here. BT_DIS_FW_REV_STR
# defaults to "$(APP_VERSION_TWEAK_STRING)", which Zephyr derives from the
# VERSION file — the same value imgtool stamps into the MCUboot image header.
# Hard-coding it would let DIS drift from the release; leaving it alone makes
# drift impossible.
CONFIG_BT_DIS_FW_REV=y
# Per-unit serial, written at boot by src/dis from the Bluetooth identity
# address. Runtime DIS strings require BT_DIS_SETTINGS -> SETTINGS; with no
# NVS/ZMS/FCB/FILE in this build the SETTINGS_BACKEND choice falls through to
# SETTINGS_NONE, so this costs no storage partition — only the settings core.
# (BT_SETTINGS has no `default y`, so ble_core.c's settings_load() path stays
# inactive and bonding behaviour is unchanged.)
CONFIG_BT_DIS_SERIAL_NUMBER=y
CONFIG_BT_DIS_SERIAL_NUMBER_STR="unprogrammed"
CONFIG_BT_DIS_SETTINGS=y
CONFIG_SETTINGS_RUNTIME=y
# BT_DIS_SETTINGS turns each DIS string into a uint8_t[BT_DIS_STR_MAX + 1] and
# BUILD_ASSERTs every configured literal against it. The default 21 fits
# "Hero Instruments, Inc" with exactly zero slack; 32 leaves room to rename.
CONFIG_BT_DIS_STR_MAX=32
# No SIG / USB-IF vendor ID has been assigned to us, and PnP_ID defaults on with
# VID 0x0000 — advertising an invalid ID is worse than omitting the characteristic.
CONFIG_BT_DIS_PNP=n

# --- Channel Sounding -------------------------------------------------------
CONFIG_BT_CHANNEL_SOUNDING=y
CONFIG_BT_CTLR_CHANNEL_SOUNDING_TEST=n
CONFIG_BT_CTLR_EXTENDED_FEAT_SET=y     # required for inline-PCT (IPT); harmless for RAS
CONFIG_BT_TRANSMIT_POWER_CONTROL=y

# --- RAS: both Requestor (initiator) and Responder (reflector) --------------
CONFIG_BT_RAS=y
CONFIG_BT_RAS_RREQ=y
CONFIG_BT_RAS_RRSP=y
CONFIG_BT_RAS_MODE_3_SUPPORTED=n

# --- Distance estimation library (shared by RAS + IPT) ----------------------
CONFIG_BT_CS_DE=y
CONFIG_BT_CS_DE_1024_NFFT=y
CONFIG_FPU=y
CONFIG_FPU_SHARING=y
CONFIG_CBPRINTF_FP_SUPPORT=y

# --- Scanning: UUID filter for RAS, name filter for IPT ---------------------
CONFIG_BT_SCAN=y
CONFIG_BT_SCAN_FILTER_ENABLE=y
CONFIG_BT_SCAN_UUID_CNT=1
CONFIG_BT_SCAN_NAME_CNT=1

# --- Larger MTU/buffers (RAS Ranging Profile recommends >= 247-octet MTU) ---
CONFIG_BT_L2CAP_TX_MTU=498
CONFIG_BT_BUF_ACL_TX_SIZE=502
CONFIG_BT_BUF_ACL_RX_SIZE=502
CONFIG_BT_ATT_PREPARE_COUNT=3
CONFIG_BT_CTLR_DATA_LENGTH_MAX=251
CONFIG_BT_CTLR_PHY_2M=y

# --- Buffering: high-rate motion notifications + bulk SMP image upload ------
# Counts follow the Aruba ring firmware, which does OTA over this same host.
CONFIG_BT_ATT_TX_COUNT=8
CONFIG_BT_L2CAP_TX_BUF_COUNT=15
CONFIG_BT_BUF_ACL_TX_COUNT=30
CONFIG_BT_BUF_ACL_RX_COUNT_EXTRA=8
CONFIG_BT_BUF_EVT_RX_COUNT=35
CONFIG_BT_RX_STACK_SIZE=4096
CONFIG_BT_CONN_TX_MAX=30

# --- Shorter Connection Intervals (SCI): sub-7.5 ms on the tag<->tag link ---
# Requires Extended Feature Set (above) + Subrating + Frame Space Update.
CONFIG_BT_LE_EXTENDED_FEAT_SET=y
CONFIG_BT_SUBRATING=y
CONFIG_BT_FRAME_SPACE_UPDATE=y
CONFIG_BT_SHORTER_CONNECTION_INTERVALS=y
# Connection-event length. This was 750 us so an event fits inside the sub-7.5 ms
# SCI interval — but at 750 us the controller cannot fit a 251-byte PDU, so it
# silently refuses data-length extension. Every ATT write then fragments ~19 ways
# and a single dropped fragment deadlocks an SMP upload (reassembly has no
# retransmission). 33500 matches the Aruba ring firmware, whose OTA works.
# NB: re-verify two-tag Channel Sounding after changing this.
CONFIG_BT_CTLR_SDC_MAX_CONN_EVENT_LEN_DEFAULT=33500
# Don't let the host auto-update conn params and fight the SCI rate.
CONFIG_BT_GAP_AUTO_UPDATE_CONN_PARAMS=n

# Do NOT set BT_CTLR_SDC_CS_ROLE_*_ONLY — dual-role needs both roles.

# --- Sensors ----------------------------------------------------------------
CONFIG_SENSOR=y

# --- Logging + shell (over RTT; build with `-S rtt-console`) ----------------
# This board has no UART, so bind the shell to the SEGGER RTT backend
# (the default serial backend has no console device to attach to).
CONFIG_LOG=y
# Deferred (full) log mode — the default minimal mode supports neither runtime
# filtering nor the `log` shell command.
CONFIG_LOG_MODE_DEFERRED=y
# Runtime filtering + the `log` shell command give whole-module log control
# (`log enable/disable <lvl> <module>` for app_ble_core, app_cs, ...).
CONFIG_LOG_RUNTIME_FILTERING=y
CONFIG_LOG_CMDS=y
CONFIG_SHELL=y
CONFIG_SHELL_BACKEND_SERIAL=n
CONFIG_SHELL_BACKEND_RTT=y
# Dummy shell backend: required by the MCUmgr shell management group below
# (it runs shell commands and captures their output). Coexists with RTT.
CONFIG_SHELL_BACKEND_DUMMY=y
# Size of that capture buffer — i.e. the hard cap on how much of a command's
# output comes back over SMP. shell_dummy.c's write() clamps the overflow and
# returns success, so anything past it is dropped *silently* (RTT is unaffected;
# it has no capture buffer). The default of 400 is not enough for `help`: its
# preamble (Tab hint + autocomplete hint + <-h> hint + the meta-keys block) is
# 396 bytes on its own, so "Available commands:" and the entire command list
# fell off the end and the shell looked empty over BLE.
# Upper bound: the captured output is encoded into one SMP response net_buf.
# cbor_nb_writer_init() hands zcbor `net_buf_tailroom()` after reserving the
# 8-byte SMP header, so the CBOR payload capacity is NETBUF_SIZE - 8 = 1222 B;
# subtract the encoding of {"o": <tstr>, "ret": n} (<=16 B) and the captured
# output may not exceed ~1206. 1184 (usable 1183) leaves 23 B of frame margin.
# Overshooting is not benign: zcbor_tstr_encode() would fail and the whole
# response becomes MGMT_ERR_EMSGSIZE rather than truncated text.
# Costs 784 B of static RAM.
CONFIG_SHELL_BACKEND_DUMMY_BUF_SIZE=1184
# ...and keep logs out of that buffer. SHELL_LOG_BACKEND routes log records into
# each shell instance, and the dummy backend's default init level is INF — a
# deferred log record landing mid-exec would interleave itself into the captured
# output and eat the byte budget above. This choice is per-backend: the RTT
# shell's log output and `log enable/disable <module>` are untouched.
CONFIG_SHELL_DUMMY_INIT_LOG_LEVEL_NONE=y

# Drop two root commands that arrived only via `default y if !SHELL_MINIMAL` and
# that this board has no use for. Both are pure cost here, and `help` is tight
# against the SMP frame: their help text alone is 306 of its 1453 bytes.
#   devmem — read/write *arbitrary physical memory*. With the SMP service left
#            open (MCUMGR_TRANSPORT_BT_PERM_RW, below), keeping it would let any
#            unpaired host in radio range peek and poke RAM/peripherals over BLE.
#   date   — Unix time get/set; nothing on this board sources a wall clock.
CONFIG_DEVMEM_SHELL=n
CONFIG_DATE_SHELL=n

# --- MCUmgr / SMP over Bluetooth (remote shell + management) ----------------
# Exposes the cs/sensor/log shell commands over BLE (mcumgr / nRF Connect
# Device Manager). The SMP-BT GATT service auto-registers at boot.
# MCUMGR depends on (does not select) NET_BUF + ZCBOR; NET_BUF comes from BT.
CONFIG_ZCBOR=y
CONFIG_MCUMGR=y
CONFIG_MCUMGR_TRANSPORT_BT=y
CONFIG_MCUMGR_TRANSPORT_BT_REASSEMBLY=y
# NCS defaults this to 2475 whenever BT reassembly is on (nrf/Kconfig.nrf:75).
# It is the buf_size advertised to the host, so it decides how many ATT writes
# each SMP frame becomes. 1230 is the value Nordic's own mcumgr_bt_ota_dfu
# module uses, and what the Aruba reference ends up with.
CONFIG_MCUMGR_TRANSPORT_NETBUF_SIZE=1230
# Aruba disables this: mcumgr renegotiating connection parameters mid-upload is
# one more thing to go wrong on a link already tuned for Channel Sounding.
CONFIG_MCUMGR_TRANSPORT_BT_CONN_PARAM_CONTROL=n
CONFIG_MCUMGR_GRP_SHELL=y
CONFIG_MCUMGR_GRP_OS=y
# SMP service permission: open (no encryption/auth). The default for BT_SMP is
# ..._PERM_RW_AUTHEN, which requires an authenticated (MITM/L3) link — unreachable
# on this NoInputNoOutput device (no pairing/IO-capability callbacks), so every SMP
# access would fail with "insufficient authentication". Open lets a screen/host use
# SMP with no pairing (acceptable for a demo).
CONFIG_MCUMGR_TRANSPORT_BT_PERM_RW=y

# --- OTA / DFU: MCUboot image management over the SMP transport above --------
# sysbuild.conf builds MCUboot (swap-using-move, ED25519); this adds the image
# management group so a host can upload a signed image into slot1 and ask
# MCUboot to swap it in. IMG_MANAGER pulls in MCUBOOT_IMG_MANAGER ->
# MCUBOOT_BOOTUTIL_LIB, which provides <zephyr/dfu/mcuboot.h>.
# NB: CONFIG_BOOTLOADER_MCUBOOT is deliberately NOT set here. Sysbuild forces it
# from SB_CONFIG_BOOTLOADER_MCUBOOT (see MAIN_image_default.cmake), so setting it
# again is redundant — and actively harmful for a --no-sysbuild build, where it
# would link the app at 0x10000 with no bootloader beneath it. That produces a
# board that flashes "successfully" and then runs nothing at all.
CONFIG_FLASH=y
CONFIG_FLASH_MAP=y
CONFIG_STREAM_FLASH=y
CONFIG_IMG_MANAGER=y
# Erase slot1 as the upload progresses instead of all 712K up front, so the
# host doesn't time out waiting for the first chunk to be accepted.
CONFIG_IMG_ERASE_PROGRESSIVELY=y
CONFIG_MCUMGR_GRP_IMG=y
# `mcuboot` shell commands (slot info / confirm / erase / request_upgrade),
# also reachable over BLE through MCUMGR_GRP_SHELL above.
CONFIG_MCUBOOT_SHELL=y
# Let the host discover our SMP buffer size so it uploads in large chunks.
CONFIG_MCUMGR_GRP_OS_MCUMGR_PARAMS=y
# Image-upload notifications, consumed by src/dfu (pauses CS during upload).
CONFIG_MCUMGR_MGMT_NOTIFICATION_HOOKS=y
CONFIG_MCUMGR_GRP_IMG_STATUS_HOOKS=y
# The image-upload handlers run on these; the defaults are too small.
CONFIG_MCUMGR_TRANSPORT_WORKQUEUE_STACK_SIZE=4608
CONFIG_SYSTEM_WORKQUEUE_STACK_SIZE=2560


# Enable shorter distance demo
CONFIG_APP_UX_SHORT_DEMO=y
```

## src/main.c
```c
/*
 * Copyright (c) 2026 onceLabs
 *
 * SPDX-License-Identifier: BSD-3-Clause
 */
/*
 * nRF54L15 Tag Demo
 *
 * Dual-role, dual-mode (RAS + inline-PCT) Bluetooth Channel Sounding plus
 * onboard sensor sampling. Functional areas live in self-contained modules
 * under src/; each is enabled by its own CONFIG_APP_* symbol.
 */
#include <zephyr/kernel.h>
#include <zephyr/logging/log.h>

#include "dfu/dfu.h"
#include "sensors/sensors.h"
#include "ble/ble_core.h"
#include "ble/adv.h"
#include "cs/cs_shared.h"
#include "ess/ess.h"
#include "dis/dis.h"
#include "motion/motion.h"
#include "tput/tput.h"
#include "ux/ux.h"

LOG_MODULE_REGISTER(main, CONFIG_LOG_DEFAULT_LEVEL);

int main(void)
{
	int err;

	LOG_INF("nRF54L15 Tag Demo starting");

	/* First: report the running image and arm the MCUboot self-confirm timer
	 * so a bad update reverts even if a later init step hangs.
	 */
	err = dfu_init();
	if (err) {
		LOG_ERR("dfu_init failed (%d)", err);
	}

	err = sensors_init();
	if (err) {
		LOG_ERR("sensors_init failed (%d)", err);
	}

	err = ble_core_init();
	if (err) {
		LOG_ERR("ble_core_init failed (%d)", err);
	}

	err = adv_init();
	if (err) {
		LOG_ERR("adv_init failed (%d)", err);
	}

	err = cs_init();
	if (err) {
		LOG_ERR("cs_init failed (%d)", err);
	}

	err = ess_init();
	if (err) {
		LOG_ERR("ess_init failed (%d)", err);
	}

	/* After ble_core_init(): the serial number comes from bt_id_get(),
	 * which needs bt_enable() to have run.
	 */
	err = dis_init();
	if (err) {
		LOG_ERR("dis_init failed (%d)", err);
	}

	err = motion_init();
	if (err) {
		LOG_ERR("motion_init failed (%d)", err);
	}

	err = tput_init();
	if (err) {
		LOG_ERR("tput_init failed (%d)", err);
	}

	err = ux_init();
	if (err) {
		LOG_ERR("ux_init failed (%d)", err);
	}

	LOG_INF("nRF54L15 Tag Demo ready");
	return 0;
}
```
