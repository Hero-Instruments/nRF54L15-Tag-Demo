## src/ble/Kconfig
```kconfig
config APP_BLE_CORE
	bool "Bluetooth core (enable stack, connection & security handling)"
	default y
	depends on BT
	help
	  Brings up the Bluetooth stack and provides shared connection and
	  security callbacks used by the Channel Sounding modules.

config APP_ADV
	bool "Role-independent connectable advertising"
	default y
	depends on BT_PERIPHERAL && APP_CS
	help
	  Owns the single connectable advertiser so the tag is discoverable for
	  the phone-facing services (ESS/Motion/SMP) whenever idle or acting as a
	  reflector, not only during CS ranging.

config APP_ADV_IBEACON
	bool "Alternate connectable advertising with an iBeacon frame"
	default y
	depends on APP_ADV
	help
	  Every APP_ADV_IBEACON_PERIOD_S seconds switch the advertiser between
	  the connectable (ESS/Ranging + name) payload and a standard Apple
	  iBeacon frame (non-connectable, identity address). The tag cannot be
	  connected to, and a RAS initiator cannot find it, during the beacon
	  half of the cycle.

if APP_ADV_IBEACON

config APP_ADV_IBEACON_PERIOD_S
	int "Seconds spent in each advertising format"
	default 30
	range 1 3600

config APP_ADV_IBEACON_MAJOR
	hex "iBeacon major"
	default 0x0001
	range 0x0000 0xFFFF

config APP_ADV_IBEACON_MINOR
	hex "iBeacon minor"
	default 0x0001
	range 0x0000 0xFFFF

config APP_ADV_IBEACON_RSSI_1M
	int "iBeacon measured power (RSSI at 1 m, dBm)"
	default -59
	range -128 127
	help
	  Calibration byte receivers use to estimate distance. -59 dBm is the
	  usual starting point for a 0 dBm transmitter; calibrate on hardware.

endif # APP_ADV_IBEACON
```

## src/dfu/Kconfig
```kconfig
config APP_DFU
	bool "OTA / DFU image confirmation and upload hooks"
	default y
	depends on MCUMGR_GRP_IMG && BOOTLOADER_MCUBOOT
	help
	  Housekeeping around MCUboot image updates delivered over SMP: log the
	  running image version, confirm a freshly swapped-in image once it has
	  proven it can run, and quiesce Channel Sounding while an upload is in
	  flight. The manual slot commands come from Zephyr's MCUBOOT_SHELL.

if APP_DFU

config APP_DFU_CONFIRM_DELAY_S
	int "Self-confirm delay for a test image (seconds)"
	default 10
	range 0 300
	help
	  How long a newly swapped-in (unconfirmed) image must keep running
	  before it marks itself confirmed. A crash, fault or watchdog reset
	  before this deadline leaves the image unconfirmed, so MCUboot reverts
	  to the previous one on the next boot. Set to 0 to confirm immediately
	  (no revert protection).

config APP_DFU_PAUSE_CS
	bool "Stop Channel Sounding while an image upload is in progress"
	default y
	depends on APP_CS
	help
	  Writing the incoming image into RRAM stalls the CPU in bursts, which
	  disturbs Channel Sounding subevent timing. Stop ranging when an upload
	  starts; the device reboots into the new image when it completes.

endif # APP_DFU
```

## src/dis/Kconfig
```kconfig
config APP_DIS
	bool "Device Information Service serial number"
	default y
	depends on BT_DIS_SETTINGS && SETTINGS_RUNTIME
	help
	  Program the DIS Serial Number characteristic (0x2A25) from the
	  device's Bluetooth identity address at boot, so each tag reports a
	  unique serial that matches the address a scanner shows.

	  The service itself comes from Zephyr (CONFIG_BT_DIS, configured in
	  prj.conf) and registers statically at boot; this module only fills in
	  the one value that cannot be known at build time.
```

## src/tput/Kconfig
```kconfig
config APP_TPUT
	bool "Throughput test service (write / write-no-rsp / notify / indicate)"
	default y
	depends on BT_PERIPHERAL
	help
	  Custom 128-bit GATT service for measuring BLE transfer rate. One data
	  characteristic carries all four transfer paths (write without
	  response, write with response, notification, indication); a control
	  characteristic starts/stops device-to-host runs and reports per-path
	  packet and byte counters.

if APP_TPUT

config APP_TPUT_THREAD_STACK_SIZE
	int "Throughput sender thread stack size"
	default 2048

config APP_TPUT_THREAD_PRIO
	int "Throughput sender thread priority"
	default 6
	help
	  Preemptible priority for the thread that pumps notifications and
	  indications during a run.

config APP_TPUT_REQUEST_FAST_INTERVAL
	bool "Request a short connection interval when a run starts"
	default y
	help
	  Ask the central for a short connection interval at the start of a
	  device-to-host run. The central ultimately decides. Turn this off to
	  measure throughput at whatever interval the central already chose.

config APP_TPUT_CONN_INTERVAL_MIN
	int "Requested min connection interval (1.25 ms units)"
	default 6
	range 6 3200
	depends on APP_TPUT_REQUEST_FAST_INTERVAL
	help
	  6 = 7.5 ms, the BLE standard minimum. Sub-7.5 ms requires
	  controller/central support.

config APP_TPUT_CONN_INTERVAL_MAX
	int "Requested max connection interval (1.25 ms units)"
	default 6
	range 6 3200
	depends on APP_TPUT_REQUEST_FAST_INTERVAL

endif # APP_TPUT
```
